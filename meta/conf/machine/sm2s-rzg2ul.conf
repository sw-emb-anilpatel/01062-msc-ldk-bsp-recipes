## meta/conf/machine/sm2s-rzg2ul.conf
```bitbake
#@TYPE: Machine
#@NAME: smarc-rzg2ul machine
#@DESCRIPTION: RZ/G2UL SMARC platform

MACHINEOVERRIDES =. "rzg2l:rzg2ul:r9a07g043u:smarc-rzg2ul:"

SOC_FAMILY = "r9a07g043u"
require ../../meta-renesas.git/meta-rz-common/conf/machine/include/rzg2-common.inc
require ../../meta-renesas.git/meta-rz-common/conf/machine/include/cip-core.inc

DEFAULTTUNE ?= "cortexa55"

TUNE_CONF ?= "../../meta-renesas.git/meta-rzg2l/conf/machine/include/tune-cortexa55.inc"
require ${TUNE_CONF}

PREFERRED_PROVIDER_virtual/kernel = "linux-renesas"
UBOOT_CONFIG ??= "sm2s-rzg2ul"
UBOOT_CONFIG[sm2s-rzg2ul] = "sm2s-rzg2ul_defconfig"

# flash writer
EXTRA_IMAGEDEPENDS += " flash-writer"
EXTRA_IMAGEDEPENDS += " u-boot"
EXTRA_IMAGEDEPENDS += " firmware-pack"

IMAGE_FSTYPES += "wic wic.bmap"

# Supported devicetree
KERNEL_DEVICETREE = " \
	msc/rzg2ul/msc-sm2s-g2ul-sc-14N02C1I-module.dtb \
	msc/rzg2ul/msc-sm2s-g2ul-sc-92NON70E-module.dtb \
	msc/rzg2ul/overlay-baseboard-ep1.dtb \
	msc/rzg2ul/overlay-baseboard-vebo.dtb \
	msc/rzg2ul/overlay-lvds-ama-070a04.dtb \
	msc/rzg2ul/overlay-lvds-ama-101a07.dtb \
	msc/rzg2ul/overlay-lvds-ama-121a01.dtb \
"

ROOTFS_POSTPROCESS_COMMAND_remove += " remove_boot; "

IMAGE_BOOT_FILES = " \
        bl2_bp-${MACHINE}.srec \
        fip-${MACHINE}.srec \
        Flash_Writer_SCIF_RZG2UL_SMARC_DDR4_1GB_1PCS.mot \
"
```
